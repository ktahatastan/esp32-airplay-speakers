## firmware/main/Kconfig.projbuild
```kconfig
menu "Merzarkabul Airplay Speakers board"

config HK_BOARD_DEVKIT_N8R2
    bool "Build for the ESP32-S3 N8R2 development kit"
    default n
    help
        Build for the bring-up devkit on the bench (8 MB flash, 2 MB quad PSRAM)
        instead of the N16R8 product board of ADR-0010.

        This is not a product configuration. It changes the OTA hardware revision
        from "prototype-n16r8" to "devkit-n8r2" so that a manifest published for
        one board is refused by the other, and firmware/CMakeLists.txt refuses to
        build it with application signing enabled so it can never be published.

        Leave this off unless you are flashing the devkit. Setting it by hand
        without also selecting the 8 MB flash size and the devkit partition table
        is a configure-time error, not something you discover on the bench.

config HK_ONBOARD_STATUS_LED
    bool "Mirror the status LED onto the board's own addressable LED"
    default y
    help
        The indicator ADR-0011 specifies is three PWM channels driving an
        external RGB LED. Until that LED is wired, a bare board shows no status
        at all and every state has to be read off the serial console -- which is
        true of the prototype N16R8 exactly as it was of the bring-up devkit, so
        this is no longer gated on which board is being built.

        It mirrors exactly what those PWM channels are told to do onto the single
        addressable LED most of these boards already carry. It is a mirror, not a
        second indicator: the colour comes from the same render pass, so the two
        cannot disagree about what the device is doing.

        Harmless when the board has no such LED: the RMT peripheral drives a pin
        nothing is listening to.

config HK_ONBOARD_STATUS_LED_GPIO
    int "GPIO of the board's on-board addressable LED"
    depends on HK_ONBOARD_STATUS_LED
    default 48
    help
        48 on ESP32-S3-DevKitC-1 v1.1 and later, 38 on some earlier boards and
        on several third-party clones. If the LED stays dark, this is the first
        thing to check.

        It must not collide with the assignment in hk_pins; nothing enforces that
        here, because a Kconfig integer cannot see that table.

config HK_SUPPLY_MV
    int "Amplifier supply voltage, in millivolts"
    range 8000 26000
    default 24000
    help
        The DC adapter on the 5.5 x 2.1 mm centre-positive jack, as the wiring
        plan names it: 24 V / 2.9 A, about 70 W, the rail called VIN, feeding
        all four XH-A232 amplifiers directly (ADR-0020). The amplifier accepts
        8-26 V, and the range here is that range -- a value outside it
        describes a board that cannot exist. 24 V sits 2 V under that 26 V
        maximum, which is why G1 measures the adapter's no-load output (it
        must read below 25.5 V) before the adapter is ever connected.

        This is the single place the supply voltage is stated. The firmware
        cannot measure it; it is a declaration about the adapter, and what
        consumes it is hk_profile_build(): the two PEAK ceilings in a
        driver-protection profile are stored with the supply they were set at,
        and each is scaled by min(1, reference / supply) to this value. That
        scaling is ONE-DIRECTIONAL and it errs quiet: a ceiling set at 12 V is
        halved for a 24 V build, and a supply below the reference never raises
        a ceiling above its stored value. What it halves is the DIGITAL
        ceiling, and what that means at the driver has two cases. The
        TPA3110D2 is a fixed-gain amplifier whose output follows gain x input
        until the rail clips (SLOS528F, Table 3), and the branch gains are not
        scaled. Where the 12 V bench did not clip its rail, half the ceiling
        is half the driver voltage. Where it did, the 24 V rail clips later
        and the halved ceiling can still exceed what the bench heard -- a
        driver the 12 V rail was clipping can see up to twice that voltage
        from a 24 V rail at the same slider. Which case applies is bench item
        C3, the amplifier's gain strapping, and it is unread. The scale-down
        lowers where the ceiling sits; it is not a promise about what the
        driver sees.

        The error cases are still not symmetric. A LOWER adapter left
        unconfigured is the quiet error: the ceiling is scaled for more volts
        than the rail can deliver, and the rail clips first. A HIGHER adapter
        is the danger, because the ceiling would be scaled for fewer volts
        than the driver receives -- and that is the case the no-load
        measurement exists to catch before it is plugged in.

        The 2.9 A budget is NOT expressed through these ceilings. Eight BTL
        channels can ask for far more than 70 W, a VIN that sags under the
        load can drop buck A out and reset the ESP32 mid-song, and a peak
        ceiling per branch cannot say anything about the average current of
        both branches summed. That is the profile's supply-budget field
        (supply_budget_sq, supply_window_ms): measured on the adapter in G1
        with all four amplifiers driven into 4 ohm-class loads, stored
        UNSCALED, and enforced by the DSP's supply-budget stage. The peak
        ceilings are G2's driver-protection numbers: they stay beneath that
        budget, and they do not carry it.

config HK_BENCH_PROVISIONAL_PROFILE
    bool "Use a compiled-in provisional profile when factory_cal has none"
    default n
    help
        DANGEROUS ON A BOARD WITH DRIVERS ATTACHED, and differently dangerous
        from the bench exception below: this one does not bypass a gate, it
        FEEDS it a profile nobody measured, so everything downstream behaves as
        though the speaker were calibrated.

        What it supplies: a crossover corner, a subsonic corner, branch gains,
        limiter ceilings and timings, derived on a bench from exactly two
        measurements -- the two drivers' DC resistances -- and, since profile
        schema 2, a supply-budget placeholder: one full-scale branch's worth
        of mean square (1.0), half the validator's bound of 2.0, which is a
        number G1 S7 replaces, not a budget anyone measured. With the bench
        gains (0.25 and 0.18, so at most about 0.095 of summed mean square) it
        engages only if the user EQ boosts. The tweeter's Fs was never
        located, so the corner that protects it is an argument rather than
        evidence.

        It exists because the alternative is not listening at all. hk_dsp
        refuses to run without a profile, correctly, and writing a real one into
        factory_cal is a manufacturing step. This is the bench shortcut, and the
        boot log says so in as many words every time it is used.

        Its peak ceilings are stored against the supply voltage they were
        listened to at, 12 V on the bench, and hk_profile_build() scales them
        to HK_SUPPLY_MV like any other profile's. On the 24 V adapter that
        halves the digital ceiling, and the scale-down errs quiet; it cannot
        promise the driver sees what the 12 V bench heard, because the
        amplifier is fixed-gain (see HK_SUPPLY_MV): where the bench did not
        clip its 12 V rail the driver voltage halves with the ceiling, where
        it did the 24 V rail clips later and the halved ceiling can still
        exceed what the bench heard, and bench item C3 -- the gain strapping,
        unread -- says which. Listening at 24 V is a staged, low-level
        exercise on one amplifier and one pair, and the backend logs that at
        boot whenever HK_SUPPLY_MV is not the 12 V the bench listened at.

        Off for any build that leaves the bench.

config HK_BENCH_AUDIO_WITHOUT_PROFILE
    bool "Permit audio on a board that has no driver-protection profile"
    default n
    help
        DANGEROUS ON A BOARD WITH DRIVERS ATTACHED. Leave this off unless you
        can see that nothing is connected to the audio output.

        The gate this bypasses is the one that keeps an unmeasured tweeter
        alive: without a profile from G0/G2 the DSP chain has no crossover
        corner, no protective high-pass corner and no limiter ceiling to run
        on, and hk_audio refuses rather than inventing them. The gate has two
        refusals and this lifts only the first: a profile that is absent. A
        profile that is present but refused by the judgement hk_main passes on
        it at boot with hk_profile_load() -- the same judge the DSP backend
        uses -- stays refused on the bench too, so a blob the backend would
        refuse can never unmute the DAC (ADR-0022, hk_storage.c). On a bench
        board with no DAC, no amplifier and no driver the risk is absent, and
        the receiver cannot be exercised at all while the gate is shut.

        It also makes upstream's passthrough output stage selectable in the
        hk_airplay component's output choice, for the same reason: a build that
        has declared it runs without driver protection may also run without
        the DSP. The product cannot select that stage (ADR-0022).

        It exists so that exception is written down and visible in the boot
        report, rather than being obtained by accident. Until 2026-09-08 the
        gate could be defeated without anyone deciding to: writing provisioning
        credentials put a schema version into the calibration namespace, and
        that alone was read as "calibrated".

config HK_BENCH_TONE_INSTEAD_OF_AIRPLAY
    bool "Replace the AirPlay receiver with a locally generated test tone"
    default n
    help
        DANGEROUS ON A BOARD WITH DRIVERS ATTACHED, for exactly the reason the
        symbol above is: this build makes sound, and the tone is written
        straight to I2S -- it does not pass through hk_dsp, so there is no
        crossover, no protective high-pass and no limiter in front of the
        amplifier. Leave it off unless you can see what is on the speaker
        terminals.

        It is an INSTRUMENT, not a feature. On 2026-09-08 the bench board logged
        AirPlay metadata -- so the RTSP session works -- and made
        no sound, and nothing in the log could separate "the receiver is not
        delivering samples" from "the DAC or the amplifier chain is broken".
        This symbol separates them: it puts a 1 kHz sine at -30 dBFS, generated
        by hk_tone.c, onto the same three I2S pins, so the receiver is removed
        from the question entirely. A clean tone means the fault is upstream of
        the DAC; noise or silence means it is not.

        INSTEAD OF, and the words are exact. The vendored receiver takes
        I2S_NUM_0 when it starts and holds it; so does the tone. With this set,
        hk_main does not start the receiver at all -- not the callback, not the
        RTSP server, not the mDNS advertisement -- because two owners of one
        I2S channel is a worse bug than the one being diagnosed and would be
        misread as more evidence about the DAC.

        It does not open any gate. The DAC mute still follows hk_audio's
        sequence and is still released only when the profile gate says yes,
        which on this board means HK_BENCH_AUDIO_WITHOUT_PROFILE must ALSO be
        set or the tone will be generated into an asserted mute and heard by
        nobody. hk_main says so in the log when that is the case.

        Not in sdkconfig.bench: turning this on is an operator's decision taken
        while looking at the bench, not something inherited from a file. Set it
        with `idf.py menuconfig` under "Merzarkabul Airplay Speakers board", or add
        CONFIG_HK_BENCH_TONE_INSTEAD_OF_AIRPLAY=y to a local sdkconfig fragment
        that is not committed. The source is only compiled when it is set, so a
        release image never carries it.

        HK_BENCH_SWEEP below turns this single held tone into a stepped sweep
        for measuring a driver. That is a different instrument into a different
        circuit, and its warnings are its own.

config HK_BENCH_SWEEP
    bool "Step through frequencies to measure a driver, instead of holding one tone"
    depends on HK_BENCH_TONE_INSTEAD_OF_AIRPLAY
    default n
    help
        Replaces the fixed 1 kHz tone with a stepped sine sweep, so that one
        Nova driver's impedance curve and resonance frequency (Fs) can be read
        off a multimeter. This is the measurement that closes the largest part
        of the G0 blocker in AGENTS.md.

        WHY IT MATTERS: the tweeter's Fs sets the MINIMUM SAFE high-pass corner
        -- at least twice Fs. Until it is measured, the crossover corner in
        docs/04-acoustics/measurement-and-dsp-plan.md is a conservative guess.
        The drivers came out of a Harman Kardon Nova, carry only manufacturer
        internal codes, and the woofer has an extra magnet glued to its back, so
        no published parameter applies and measurement is the only path.

        A DIFFERENT CIRCUIT, AND THIS IS THE PART TO GET RIGHT. The intended
        connection is NOT through the amplifier:

            DAC line out -> 470 ohm 1/4 W series resistor -> ONE BARE driver ->
            DAC ground, with the meter on AC volts across the driver.

        Bare means bare: if the tweeter's 10 uF C_SAFE capacitor is fitted, take
        it out of this circuit first. At 40 Hz that capacitor is about 400 ohms
        and the sweep would measure it rather than the voice coil.

        With that in place the driver dissipates tens of microwatts, and under
        half a milliwatt at a resonance peak. That is what allows the sweep to run at
        -6 dBFS -- 24 dB above the fixed tone -- and still be gentler on a
        tweeter by orders of magnitude than the fixed tone is. The level is
        chosen so the whole curve lands inside one 200 mV meter range; it is
        not a relaxed safety limit, it is the same limit applied to a circuit
        with no amplifier in it.

        THE DANGER IS THE WIRING, AND FIRMWARE CANNOT SEE IT. Left connected to
        the TPA3110, -6 dBFS through a possibly 36 dB amplifier is well past
        clipping into an unmeasured tweeter, held near its resonance for eight
        seconds at a time. Worse, the amplifier has no mute input: the bench
        exception symbol above that unmutes the DAC puts the amplifier in the
        path with it, and there is no configuration that releases one and
        holds the other. Unplug the amplifier's input or cut its supply. The
        sweep prints this and then stays silent for ten seconds before the
        first step, so there is time to act on it.

        The full procedure -- the circuit, the meter range, the arithmetic that
        turns two readings into ohms, the expected values and the table to fill
        in -- is in docs/02-hardware/driver-measurements.md. Read it before
        flashing this, not after.

        Runs to the end on its own: about three and a half minutes, then
        silence and the DAC mute back down. It needs no button and no input,
        because a run that wants a press per step is a run nobody finishes.

config HK_BENCH_SWEEP_FINE_HZ
    int "Centre a fine pass on this frequency (0: run the coarse pass)"
    depends on HK_BENCH_SWEEP
    range 0 8000
    default 0
    help
        0 runs the COARSE pass: 22 steps at 1/3 octave from 40 Hz to 4.9 kHz,
        which is wide enough to contain both the 60 mm cone's resonance and the
        25 mm dome's, and coarse enough that a person will actually finish
        writing it down.

        Set this to the frequency of the largest reading that pass produced,
        and the next run is a FINE pass instead: 17 steps at 1/12 octave across
        two thirds of an octave either side of it. The coarse pass says which
        neighbourhood Fs is in to about 13%; the fine pass says where it is to
        about 3%, which is what a high-pass corner deserves to be derived from.

        Two passes rather than one long fine sweep because a 1/12-octave sweep
        of the whole range is 122 steps and a quarter of an hour of copying
        numbers off a meter, and eighty of those steps are known in advance to
        be flat.

        Clamped to 20 Hz - 7.35 kHz by the generator regardless of what is set
        here, because outside that band the block length stops fitting the
        buffer at one end and the sample rate stops describing a sine at the
        other.

config HK_DUAL_TRANSPORT
    bool "Offer BLE and SoftAP provisioning at the same time"
    default y
    help
        ADR-0005 offered one transport at a time because ESP-IDF's provisioning
        manager takes one scheme. That is still true of the MANAGER -- but since
        ADR-0015 the SoftAP leg no longer goes through it: the captive portal
        hands credentials over with wifi_prov_mgr_configure_sta(), so it needs no
        scheme, no protocomm instance and no second manager. The singleton only
        has to serve BLE.

        So both are offered from the first second of a factory-fresh boot and the
        phone picks. The manager runs BLE; the access point and the portal are
        brought up alongside it by hk_network.

        Neither leg asks for a PIN and the access point is open (ADR-0023):
        BLE runs protocomm Security 1 without a proof of possession, the
        setup network has no key, and both advertise one name with the PROV_
        prefix the stock Espressif apps list by default. Nothing stored on the
        board is needed for setup to open.

        One honest limit: WIFI_PROV_SCHEME_BLE_EVENT_HANDLER_FREE_BTDM releases
        the Bluetooth stack when the window closes, and that release cannot be
        undone without a reboot. The product statement is therefore "both at
        first boot, BLE until that window closes".

        Turn this off to fall back to one transport at a time.

config HK_FIRST_BOOT_BLE
    bool "Open BLE instead of SoftAP when the device has no credentials"
    default y
    help
        ADR-0005 sent a device with nothing stored to SoftAP, on the reasoning
        that the app-less path must always be reachable. The owner's stated
        priority is the opposite: BLE provisioning with a QR is the setup path
        they actually use, and on 2026-09-08 it was the one they went looking
        for on a new board and could not find.

        INTERIM. This contradicts an accepted decision, so the policy is not
        settled here -- it is settled by the ADR that supersedes ADR-0005/0015's
        transport rule, once it is known whether both transports can be open at
        once. What this switch does today is make BLE reachable on a board that
        has no credentials, so it can be tested at all.

        With this off, the ADR-0005 rule applies: no credentials opens SoftAP,
        and BLE waits for a button press on a configured device.

config HK_DEVKIT_WIFI_SSID
    string "Bench Wi-Fi SSID to preload (empty: do not preload)"
    depends on HK_BOARD_DEVKIT_N8R2
    default ""
    help
        A convenience for the bench, and only for the bench.

        The devkit has no button, so the 5-second press that clears credentials
        cannot be given, and joining its SoftAP from the machine driving the
        board would drop that machine off the network it is being told to join.
        This lets the board be put on a network over USB instead.

        Put the value in firmware/sdkconfig.devkit.local, which is ignored by
        git. Do not put it in sdkconfig.devkit: that file is committed, and this
        one carries somebody's actual Wi-Fi password.

        Empty means preload nothing, which is the default and the only setting
        that should ever be committed. Existing stored credentials are never
        overwritten.

config HK_DEVKIT_WIFI_PASSWORD
    string "Bench Wi-Fi password to preload (empty: do not preload)"
    depends on HK_BOARD_DEVKIT_N8R2
    default ""
    help
        See HK_DEVKIT_WIFI_SSID. This is a real password: it ends up in the
        built image, which is why it is confined to the bench board and to a
        file that is never committed.

endmenu
```
