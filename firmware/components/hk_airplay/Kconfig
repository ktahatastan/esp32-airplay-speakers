## firmware/components/hk_airplay/Kconfig
```kconfig
menu "Harman Kardom AirPlay"

config HK_AIRPLAY
    bool "Build the vendored AirPlay 2 receiver (ADR-0007)"
    default n
    help
        Compile and link the AirPlay receiver vendored under
        components/hk_airplay/vendor at the commit ADR-0007 pins.

        Off by default. The receiver drives I2S, and on the product board that
        is not allowed until the driver-protection gates (G0/G2) have produced
        a calibration profile -- hk_airplay_start() refuses in that case anyway,
        but leaving the code out entirely keeps the product image and its size
        budget unchanged until the decision is actually made.

        The upstream licence is non-commercial. Enabling this binds the whole
        firmware to those terms; see ADR-0007.

if HK_AIRPLAY

# --- Values the vendored sources read.
#
#     Declared here rather than by vendoring upstream's Kconfig, so that
#     vendor/ stays byte-identical to upstream and the settings this project
#     actually made are visible in one file instead of buried in a 523-line
#     menu describing boards, displays and amplifiers that do not exist here.

config I2S_BCK_IO
    int "I2S bit clock GPIO"
    default 4
config I2S_WS_IO
    int "I2S word select GPIO"
    default 5
config I2S_DO_IO
    int "I2S data output GPIO"
    default 6
config I2S_SCK_IO
    int "I2S master clock GPIO (-1 for none)"
    default -1
    help
        No master clock. The PCM5102A of ADR-0002 recovers its clock with an
        internal PLL, so an MCLK line would be a pin spent on nothing.
config I2S_VCC_IO
    int "GPIO used to power a DAC module (-1 for none)"
    default -1
config I2S_GND_IO
    int "GPIO used as a DAC module ground (-1 for none)"
    default -1
    help
        Upstream supports small DAC breakout boards powered from spare GPIOs.
        This design powers the DAC from the supply rail, so both are -1.

choice HK_AIRPLAY_OUTPUT
    prompt "Where the receiver sends audio"
    default HK_AIRPLAY_OUTPUT_I2S

config HK_AIRPLAY_OUTPUT_I2S
    bool "I2S to the PCM5102A (the product's output, ADR-0002)"

config HK_AIRPLAY_OUTPUT_DSP
    bool "I2S to the PCM5102A, through the crossover and driver protection"
    help
        The same I2S output as above, with this project's DSP in it: the mono
        downmix, the LR4 crossover, the woofer's subsonic high-pass and the two
        limiters. Left carries the WOOFER and right the TWEETER (ADR-0002).
        This is not a stereo pair, and selecting it on a box wired as one sends
        a low-passed signal to one speaker and a high-passed signal to the
        other.

        OFF BY DEFAULT, and it needs a calibration profile to do anything.
        The crossover corner, the subsonic corner, the branch gains and both
        limiter ceilings all come from a stored `factory_cal` profile produced
        at G0 and G2 (hk_profile.h). WITHOUT ONE THIS BACKEND OUTPUTS DIGITAL
        ZERO: the receiver runs, mDNS advertises, I2S is clocked, and nothing is
        audible. That is deliberate. The alternative -- passing audio through
        with the crossover bypassed -- would put full-range programme with no
        protective high-pass and no ceiling on a tweeter whose Fs has not been
        measured, which is the one failure the profile exists to prevent.

        So a silent speaker on this setting is the setting working. Check the
        boot log: the backend says plainly which of the two it is doing.

        It lives in output/hk_airplay_output_i2s.c and SHADOWS
        vendor/audio/audio_output.c -- same DMA geometry, same playout cursor,
        same latency reporting, same task priority -- because ADR-0013 forbids
        editing the vendored tree. The two are kept in step by review, enforced
        by scripts/check_vendor_output_shadow.py.

config HK_OUTPUT_SWAP_BRANCHES
    bool "The woofer is on the RIGHT analogue channel, not the left"
    depends on HK_AIRPLAY_OUTPUT_DSP
    default n
    help
        Swaps the two branches on the way out, so the woofer branch leaves on
        the right analogue channel and the tweeter branch on the left.

        ADR-0002 and the wiring plan both say left is the woofer, and the DSP
        produces exactly that. This exists because the plan describes intent
        while a bench describes what somebody actually soldered -- a PCM5102A
        module labelled the other way round, or a crossed pair of input leads,
        puts full-band bass into a tweeter the moment a crossover starts
        working. Until that moment it is invisible: with a mono programme both
        channels carry the same samples, so nothing can distinguish them.

        Which is why this is a switch rather than a soldering iron. Four
        speakers get wired by hand and they will not all be wired the same.

        HOW TO TELL: play quietly and listen close to each driver. If the bass
        is coming from the tweeter this is the wrong way round -- and turn it
        down before you go looking, because that is the failure it prevents.

config HK_AIRPLAY_OUTPUT_SPDIF
    bool "Coaxial S/PDIF, bit-banged through I2S"
    help
        A bench output, not a product one. It exists so audio can be HEARD
        before the PCM5102A modules arrive: the receiver's decode, clock and
        timing are all exercised, and an external DAC does the conversion.

        Only the data pin carries signal; no bit or word clock is emitted. It
        needs three passive parts between the GPIO and the coax centre, because
        S/PDIF wants 0.5 V into 75 ohm and a GPIO swings 3.3 V:

            GPIO --[210R]--+--[100nF]-- coax centre
                           |
                         [110R]
                           |
            GND -----------+---------- coax shield

        Loaded by a 75 ohm input that yields 0.58 Vpp, inside the 0.5 V +/-20%
        the standard allows, with a source impedance of 72 ohm. Driving the
        cable straight from the GPIO is out of spec in both.

endchoice

config SPDIF_DO_IO
    int
    depends on HK_AIRPLAY_OUTPUT_SPDIF
    default 6
    help
        Not a free choice: it must be the pin ADR-0011 reserved for audio data,
        and hk_airplay.c asserts that at compile time. S/PDIF replaces the I2S
        output rather than joining it, so it belongs on the same pin.

config OUTPUT_SAMPLE_RATE_HZ
    int
    default 44100
    help
        AirPlay's own rate. Resampling would cost CPU and quality to arrive at
        a rate nothing here needs.

config RESAMPLER_TAPS
    int
    default 28

config AIRPLAY_TIMING_THRESHOLD_MS
    int
    default 25
config AIRPLAY_RT_TIMING_THRESHOLD_MS
    int
    default 50

config AIRPLAY_FORCE_V1
    bool "Advertise AirPlay 1 only"
    default n
    help
        Off: the receiver offers AirPlay 2, which is what PRD-002 needs for
        multiroom. ADR-0007 keeps this switch as the documented retreat if the
        G7 synchronisation measurement fails.

config ENABLE_AIRPLAY_ARTWORK
    bool "Receive cover art"
    default n
    help
        Off. There is no display, so artwork would be received and dropped --
        paid for in the memory budget the jitter buffer needs.

endif

endmenu
```
